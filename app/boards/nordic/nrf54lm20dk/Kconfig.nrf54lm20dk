## app/boards/nordic/nrf54lm20dk/Kconfig.nrf54lm20dk
```kconfig
config BOARD_NRF54LM20DK
    select SOC_NRF54LM20B_CPUAPP if BOARD_NRF52840DK_NRF54LM20B_CPUAPP_ZMK
    select ZMK_BOARD_COMPAT if BOARD_NRF52840DK_NRF54LM20B_CPUAPP_ZMK
```

## app/boards/nordic/nrf54lm20dk/nrf54lm20dk_nrf54lm20b_cpuapp_zmk_defconfig
```kconfig
# Copyright (c) 2026 The ZMK Contributors
# SPDX-License-Identifier: MIT

# Enable MPU
CONFIG_ARM_MPU=y

# enable GPIO
CONFIG_GPIO=y

# USB and BLE HID
CONFIG_ZMK_USB=y
CONFIG_ZMK_BLE=y
```
